## config/boards/shields/sofle_pandakb/Kconfig.defconfig
```kconfig
if SHIELD_SOFLE_PANDAKB_LEFT

config ZMK_KEYBOARD_NAME
    default "Sofle PandaKB"

config ZMK_SPLIT_ROLE_CENTRAL
    default y

endif

if SHIELD_SOFLE_PANDAKB_RIGHT

config ZMK_KEYBOARD_NAME
    default "Sofle PandaKB Right"

endif

if SHIELD_SOFLE_PANDAKB_LEFT || SHIELD_SOFLE_PANDAKB_RIGHT

config ZMK_SPLIT
    default y

endif
```

## config/boards/shields/sofle_pandakb/Kconfig.shield
```kconfig
config SHIELD_SOFLE_PANDAKB_LEFT
    def_bool $(shields_list_contains,sofle_pandakb_left)

config SHIELD_SOFLE_PANDAKB_RIGHT
    def_bool $(shields_list_contains,sofle_pandakb_right)
```
